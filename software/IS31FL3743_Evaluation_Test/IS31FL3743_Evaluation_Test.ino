/*
  Copyright (C) 2023 Julian Metzler

  This program is free software: you can redistribute it and/or modify
  it under the terms of the GNU General Public License as published by
  the Free Software Foundation, either version 3 of the License, or
  (at your option) any later version.

  This program is distributed in the hope that it will be useful,
  but WITHOUT ANY WARRANTY; without even the implied warranty of
  MERCHANTABILITY or FITNESS FOR A PARTICULAR PURPOSE.  See the
  GNU General Public License for more details.

  You should have received a copy of the GNU General Public License
  along with this program.  If not, see <http://www.gnu.org/licenses/>.
*/

#include "is31fl3743.h"

// Generated by image2cpp
const uint32_t image[] = {
// 'test', 6x11px
0x00ff0100, 0x00ff0001, 0x00ff2401, 0x00ff4801, 0x00ff8f01, 0x00ffd601, 
0x00ff2400, 0x00ff6b00, 0x00ff8f01, 0x00ffd601, 0x00e2ff01, 0x009aff00, 
0x00ffb300, 0x00ffd601, 0x00e2ff00, 0x009bff01, 0x0054ff00, 0x000dff00, 
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0x00e200ff, 0x00ff01d6, 0x00ff008f, 0x00ff0048, 0x00ff0124, 0x00ff0100
};

const uint8_t gammaTable[32] = {
  0, 1, 2, 3, 6, 10, 13, 18, 22, 28, 33, 39, 46, 53, 61, 69, 78, 86, 96, 106, 116, 126, 138, 149, 161, 173, 186, 199, 212, 226, 240, 255
};

void setup() {
  is31fl3743_init();
  is31fl3743_setGlobalBrightness(4);

  for (uint8_t i = 0; i < 3*6*11; i++) {
    is31fl3743_setPixelScalingFactor(i, 0xFF);
  }

  for (uint8_t y = 0; y < 11; y++) {
    for (uint8_t x = 0; x < 6; x++) {
      uint8_t i = y * 6 + x;
      is31fl3743_setPixelRGB(x, y, image[i]);
    }
  }
}

void loop() {
  // Display a pink horizontal line moving up and down on a dim white background
  /*for (uint8_t y = 0; y < 11; y++) {
    for (uint16_t i = 1; i <= 3*6*11; i++) {
      uint8_t data = (((i-1) / 18) == y) ? (((i)%3 == 0 || (i+2)%3 == 0) ? 0xFF : 0x08) : 0x08;
      is31fl3743_write(0, i, &data, 1); // Write to PWM register
    }
    delay(20);
  }
  for (int8_t y = 10; y >= 0; y--) {
    for (uint16_t i = 1; i <= 3*6*11; i++) {
      uint8_t data = (((i-1) / 18) == y) ? (((i)%3 == 0 || (i+2)%3 == 0) ? 0xFF : 0x08) : 0x08;
      is31fl3743_write(0, i, &data, 1); // Write to PWM register
    }
    delay(20);
  }*/

  // Breathing effect with global brightness
  for (uint8_t i = 0; i < 32; i++) {
    uint8_t data = gammaTable[i];
    is31fl3743_write(2, 0x01, &data, 1); // Write to global current register at 0x01
    delay(50);
  }
  for (uint8_t i = 0; i < 32; i++) {
    uint8_t data = gammaTable[31-i];
    is31fl3743_write(2, 0x01, &data, 1); // Write to global current register at 0x01
    delay(50);
  }
}
